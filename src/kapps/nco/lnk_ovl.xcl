-cZ80
-Ilist
/*
 * Overlay link: low 0100-7FFF MUST match lnk.xcl (root multibank.com).
 * Bank-only code/const/strings -> *_RESIDENT @8000.
 * Makefile rewrites RSEG CSTR/CONST -> CSTR_RESIDENT/CONST_RESIDENT.
 */
-Z(CODE)RCODE,CODE,CDATA0,CONST,CSTR,CCSTR=0100-7FFF
-Z(DATA)DATA0,IDATA0,ECSTR,NO_INIT,UDATA0,CSTACK+250=0100-7FFF
-Z(CODE)CODE_RESIDENT,CONST_RESIDENT,CSTR_RESIDENT,CCSTR_RESIDENT=8000-BFFF
