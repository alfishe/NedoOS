-cZ80
-Ilist
/* Main: 0100-BFFF. Bank window C000: CODE_RESIDENT + runtime data pages. */
-Z(CODE)RCODE,CODE,CDATA0,CONST,CSTR,CCSTR=0100-BFFF
-Z(DATA)DATA0,IDATA0,ECSTR,NO_INIT,UDATA0,CSTACK+250=0100-BFFF
-Z(CODE)CODE_RESIDENT=C000-FFFF
