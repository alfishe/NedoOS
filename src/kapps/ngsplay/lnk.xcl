-cZ80
-Ilist
/* Main: 0100-BFFF. Bank window C000: CODE_RESIDENT + runtime data/IOBUF pages. */
-Z(CODE)RCODE,CODE,CDATA0,CONST,CSTR,CCSTR=0100-BFFF
-Z(DATA)DATA0,IDATA0,ECSTR,NO_INIT,UDATA0,CSTACK+512=0100-BFFF
-Z(CODE)CODE_RESIDENT=C000-FFFF
-e_medium_write=_formatted_write
-e_medium_read=_formatted_read
