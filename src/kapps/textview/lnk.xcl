-cZ80
-Ilist
/* Code+data 0100-BFFF; document pages mapped at C000 (OS_SETPGC000). */
-Z(CODE)RCODE,CODE,CDATA0,CONST,CSTR,CCSTR=0100-BFFF
-Z(DATA)DATA0,IDATA0,UDATA0,ECSTR,NO_INIT,CSTACK+2E0=0100-BFFF
-e_medium_write=_formatted_write
-e_medium_read=_formatted_read