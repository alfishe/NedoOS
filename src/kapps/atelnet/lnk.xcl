-cZ80
-Ilist
/* Main image 0100-BFFF; resident bank window @ C000 (telbook + CLI). */
/* CSTACK+NNN size is hex (+280 = 640 bytes). */
-Z(CODE)RCODE,CODE,CDATA0,CONST,CSTR,CCSTR=0100-BFFF
-Z(DATA)DATA0,IDATA0,ECSTR,NO_INIT,UDATA0,CSTACK+280=0100-BFFF
-Z(CODE)CODE_RESIDENT,CSTR_RESIDENT,CONST_RESIDENT=C000-FFFF
-Z(DATA)UDATA_RESIDENT,IDATA_RESIDENT=C000-FFFF
-e_medium_write=_formatted_write
-e_medium_read=_formatted_read
