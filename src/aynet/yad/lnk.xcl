-l list/cout.html 
-xehinms 
-Z(CODE)DBGMON=FFFF-FFFF 
../../_sdk/iar.lib 
-C ../../../iar/lib/clz80
-cZ80 //процессор, под который собираем
-Ilist
-Z(CODE)RCODE,CODE,CDATA0,CONST,CSTR,CCSTR=0100-3FFF //сегменты памяти с константами и кодом
-Z(CODE)PLAYER=4000-5FFF //плеер
-Z(DATA)RXBUF=6000-7FFF //буфер
-Z(DATA)DATA0,IDATA0,UDATA0,ECSTR,NO_INIT,CSTACK+200,FREESEG=8000-FBFF //сегменты стека, переменных и т.п.
-e_medium_write=_formatted_write //конфигурация printf/sprintf  
-e_medium_read=_formatted_read //конфигурация scanf/sscanf 

