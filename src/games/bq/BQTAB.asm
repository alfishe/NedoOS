        ;MAIN "*",#C6
        DS (-$)&0xff
;для каждого типа персонажей:
  ;адрес программы движения (_NAME)
  ;адрес таблицы фаз (pNAME)
TPERSTYPE
;0-го персонажа не существует (0=конец цепочки)
        DW RETER
;герой
IDhero=$&0xff
        DW _HERO
        DW pHERO
IDerased=$&0xff
        DW _EMPTY
        DW pERASED
ID5=$&0xff
        DW _NUMBER
        DW pN5
ID10=$&0xff
        DW _NUMBER
        DW pN10
ID15=$&0xff
        DW _NUMBER
        DW pN15
ID25=$&0xff
        DW _NUMBER
        DW pN25
ID50=$&0xff
        DW _NUMBER
        DW pN50
IDdoskabrk=$&0xff
        DW _EMPTY
        DW pDOSKABRK
IDglassVbr=$&0xff
        DW _EMPTY
        DW pGLASSVBR

       DS 64-($&0xff)

;отсюда и до IDlog бонусы
IDapple=$&0xff
        DW _EMPTY
        DW pAPPLE
IDexit=$&0xff
        DW _EXIT
        DW pEXIT
IDarr=$&0xff
        DW _ARR_L
        DW pARRIGHT
IDarl=$&0xff
        DW _ARR_L
        DW pARLEFT
IDaru=$&0xff
        DW _ARU_D
        DW pARUP
IDard=$&0xff
        DW _ARU_D
        DW pARDOWN
IDlife=$&0xff        ;NU
        DW _EMPTY;_LIFE
        DW pHERO;pLIFE
IDkey=$&0xff
        DW _EMPTY
        DW pKEY
IDweight=$&0xff
        DW _EMPTY
        DW pWEIGHT
IDdiam=$&0xff
        DW _EMPTY
        DW pDIAM
IDhourglass=$&0xff
        DW _EMPTY
        DW pHOURGLASS
IDspi=$&0xff
        DW _SPIDER
        DW pSPI
IDbottle=$&0xff
        DW _EMPTY
        DW pBOTTLE

       DS 128-(($-IDapple)&0xff)

;отсюда препятствия
IDlog=$&0xff
        DW RETER ;выход из цикла
        DW pLOG
IDdoska=$&0xff
        DW RETER ;выход из цикла
        DW pDOSKA
IDbeton=$&0xff
        DW RETER ;выход из цикла
        DW pBETON

       DS 224-($&0xff)

;отсюда вер. препятствия
IDlogV=$&0xff
        DW RETER ;выход из цикла
        DW pLOGV
IDglassV=$&0xff
        DW RETER ;выход из цикла
        DW pGLASSV
IDbetonV=$&0xff
        DW RETER ;выход из цикла
        DW pBETONV

;для каждого типа персонажей:
  ;pgspr
  ;addrphase0
  ;addrphase1
  ;...
;фазы перебираются от последней к первой!
pKEY
        DB pgspr2
KEYFIG  DW key1
pWEIGHT
        DB pgspr2
WGTFIG  DW weight1
pSPI
        DB pgspr2
SPIFIG  DW spi1
pHERO
        DB pgspr
        DW s0
        DW s2
        DW s4
        DW s6
        DW s8
        DW sA
        DW sC
        DW sE
        DW sG
        DW sI
        DW sK
        DW sM
        DW sO
        DW sQ
        DW sS
        DW sU
pLOG
        DB pgspr
        DW treelog
pDOSKA
        DB pgspr
        DW doska
pDOSKABRK
        DB pgspr
        DW doskabrk
pBETON
        DB pgspr
        DW beton
pBETONV
        DB pgspr
        DW betonv
pLOGV
        DB pgspr
        DW logv
pGLASSV
        DB pgspr
        DW glassv
pGLASSVBR
        DB pgspr
        DW glassvbr
pN5
        DB pgspr
        DW n5
pN10
        DB pgspr
        DW n10
pN15
        DB pgspr
        DW n15
pN25
        DB pgspr
        DW n25
pN50
        DB pgspr
        DW n50
pERASED
        DB pgspr2
        DW sprempty
        DW sprempty ;защита от глюка при стирании exit
pBOTTLE
        DB pgspr2
BOTFIG  DW bottle1
pARRIGHT
        DB pgspr2
        DW arright
pARLEFT
        DB pgspr2
        DW arleft
pARUP
        DB pgspr2
        DW arup
pARDOWN
        DB pgspr2
        DW ardown
pEXIT
        DB pgspr2
        DW sprempty
EXITFIG DW exit1
pDIAM
        DB pgspr2
DIAMFIG DW diam1
pAPPLE
        DB pgspr
CHEFIG  DW ch1
pHOURGLASS
        DB pgspr
HOURFIG DW sand1

THIGH   DB "HIGH:",0
TLAST   DB "LAST:",0
TTIME2  DB "030",0
TWORLD2 DB "01",0
lascore DW 0
hiscore DW 0
tLEVCOM
 db 0x00,0x01,0x02,0x03,0x00,0x04,0x02,0x03,0x00,0x01,0x01,0x0B,0x0C,0x0B,0x0D,0x0E,0x0F,0x10,0x0D,0x00,0x01,0x02,0x03,0x11,0x12,0x02,0x03,0x01,0x13
 db 0x05,0x06,0x07,0x08,0x09,0x0A,0x07,0x08,0x05,0x06,0x01,0x14,0x15,0x14,0x16,0x17,0x18,0x19,0x1A,0x05,0x06,0x07,0x08,0x1B,0x1C,0x07,0x08,0x01,0x1D
tTIMEOUT
 db 0x11,0x12,0x1E,0x0E,0x0F,0x02,0x03,0x01,0x0B,0x0D,0x00,0x04,0x11,0x12,0x01,0x13
 db 0x1B,0x1C,0x1F,0x17,0x18,0x07,0x08,0x01,0x14,0x16,0x14,0x16,0x1B,0x1C,0x01,0x1D
tGAMEOVER
 db 0x0B,0x20,0x0B,0x0D,0x0E,0x0F,0x02,0x03,0x01,0x0B,0x0D,0x00,0x04,0x02,0x03,0x10,0x21,0x01,0x13
 db 0x22,0x23,0x24,0x25,0x17,0x18,0x07,0x08,0x01,0x14,0x16,0x09,0x0A,0x07,0x08,0x19,0x26,0x01,0x1D
