demokey
showdemo=$ ;55=show
        OR A
      IF demorec==0
        jr NC,nshow
      ENDIF 
       LD A,(MKEY)
    if 0
      IF demorec==0
       CPL 
       AND 63;31
       jr Z,$+7
        LD A,4 ;break
        LD (gameover),A
      ENDIF 
    endif
demoRADR=$+1
       LD HL,DEMOSTART
      IF demorec==0
       LD A,(HL)
      ELSE 
      LD (HL),A
      ENDIF 
       INC HL
       LD (demoRADR),HL
      DISPLAY /T,demoRADR
       LD (MKEY),A
nshow
        ret

logic
        call OUTIQ
        
        CALL MOVEANIM      

;=============== ОБРАБОТКА ИГРОВОГО ЦИКЛА
cycler=$+1
        LD A,0
        DEC A
        LD (cycler),A
        LD IX,HEROES
      ;ограничиваем скорости, чтобы не летать чз стены и полы
maxspd=15
       LD A,(IX+6) ;dY
       CP maxspd
       JP M,$+7
       LD (IX+6),maxspd
      ;CP -maxspd
      ;JP P,$+7
      ;LD (IX+6),-maxspd
       LD A,(IX+7) ;dX
       CP maxspd
       JP M,$+7
       LD (IX+7),maxspd
       CP -maxspd
       JP P,$+7
       LD (IX+7),-maxspd
        CALL IQ
;============ конец обработки игрового цикла
;NOCYCL
       LD A,(gameover)
       OR A
       jr NZ,nOCLK
clktimer=$+1
        LD A,50
        DEC A
        jr NZ,CLKtim
        CALL TIMEBACK
        LD A,50
CLKtim  LD (clktimer),A
nOCLK
        ret

        ;MAIN "*",#C6
BPOINT
;C(y),L(x)=координаты в знакоместах
;A возвращает состояние BMAP
      ;00-пусто
      ;01-стена
      ;10-бонус
      ;11-враг (?)
        BIT 6,L ;>63,<0
        jr NZ,BPOINTNULL
       IF byting
       PUSH HL
        LD A,C
        RRA 
        RRA 
        AND #0F
        ADD A,BMAP/256
        LD H,A
        LD A,C
        AND 3
        RRCA 
        RRCA 
        OR L
        LD L,A
        LD A,(HL)
        OR A
       POP HL
       ELSE 
        LD A,C
        RRA 
        RRA 
        AND #0F
        ADD A,BMAP/256
        LD H,A
        LD A,C
        AND 3
        INC A
        LD B,A
      ;B=1,2,3,4
        LD A,(HL)
        RLCA 
        RLCA 
        DJNZ $-2
        AND 3
       ENDIF 
        RET 
BPOINTNULL
        XOR A
        RET 
IQ
;+0 ;ID
;+1 ;phase
;+2 ;Y16
;+4 ;X16
;+6 ;speedY
;+7 ;speedX
;+8 ;energy16
;+10;time8
        LD L,(IX)
        LD H,TPERSTYPE/256
        LD C,(IX+2) ;
        LD B,(IX+3) ;Y
        LD E,(IX+4) ;
        LD D,(IX+5) ;X
        LD A,(HL)
        INC L
        LD H,(HL),L,A
        JP (HL)

;--------- подпрограммы для IQ -------------------
          ;сохраняют BC=Y, DE=X!!!
DETPOL
       PUSH BC,HL
        CALL ADLEDIV16
       ;INC C
     ;низ мяча
        CALL BPOINT
        CP wallcode
        jr NC,DETPOLY
       INC C
        CALL BPOINT
        CP wallcode
DETPOLY
       POP HL,BC
        RET 
DETPOTOL
       PUSH BC,HL
        CALL ADLEDIV16
        DEC C
       ;DEC C
     ;верхушка мяча
        CALL BPOINT
        CP wallcode
        jr NC,DETPOTOLY
       DEC C
        CALL BPOINT
        CP wallcode
DETPOTOLY
       POP HL,BC
        RET 

DETLEVO
       PUSH BC,HL
        CALL ADLEDIV16
        RL L
       DEC L
       RR L
       ;DEC L
     ;лев.край мяча
        CALL BPOINT
        CP wallcode
        jr NC,DETLEVOLY
        DEC C
        CALL BPOINT
        CP wallcode
        jr NC,DETLEVOLY
       DEC L
        CALL BPOINT
        CP wallcode
        jr NC,DETLEVOLY
        INC C
        CALL BPOINT
        CP wallcode
DETLEVOLY
       POP HL,BC
        RET 

DETPRVO
       PUSH BC,HL
        CALL ADLEDIV16
        RL L
       INC L
       RR L
       ;INC L
     ;прв.край мяча
        CALL BPOINT
        CP wallcode
        jr NC,DETPRVOLY
        DEC C
        CALL BPOINT
        CP wallcode
        jr NC,DETPRVOLY
       INC L
        CALL BPOINT
        CP wallcode
        jr NC,DETPRVOLY
        INC C
        CALL BPOINT
        CP wallcode
DETPRVOLY
       POP HL,BC
        RET 

DETBON_ENEMY
       PUSH BC,HL
        CALL ADLEDIV16
        RL L
       INC L
       RR L
        DEC C
     ;центр мяча
        CALL BPOINT
        jr NZ,DETBONOLY
        DEC C
        CALL BPOINT
        jr NZ,DETBONOLY
       INC L
        CALL BPOINT
        jr NZ,DETBONOLY
        INC C
        CALL BPOINT
DETBONOLY
       POP HL,BC
        RET 
      IF 0
RND
        PUSH HL
        LD HL,(SEED)
        LD A,H
        AND 31
        LD H,A
        LD A,(HL)
        INC H
        INC HL
        RLCA 
        ADD A,(HL)
        LD (SEED),HL
        POP HL
        RET 
      ENDIF 
DELPERS
       IF byting
        LD (IX),IDerased
       ELSE 
       PUSH BC,DE
        PUSH IX
        POP DE
        LD HL,Lunit
        ADD HL,DE
delper0 LD A,(HL),(DE),A
        OR A
        JR Z,delpQ
        LD BC,Lunit
        LDIR 
        JR delper0
delpQ  POP DE,BC
       ENDIF 
        RET 

PHASER
;H=last phase #
;L=time
;если на выходе sign=M, то анимация перезапущена сначала
        DEC (IX+10)
        RET P
        LD (IX+10),L
        DEC (IX+1)
        RET P
        LD (IX+1),H
        RET 
COLLBq
       POP IX
        OR A
        RET 
COLLBy
        PUSH IX
        POP HL
       POP IX
        SCF 
        RET 
COLLBALL
;коллизии с бонусами;CY=коллизия
;L=herowdt (ширина одного бока в полупикселях)
;H=herohgt*2 (в полупикселях)
        LD A,L,(COLLwdt),A
        LD A,H,(COLLhgt2),A
       PUSH IX
        LD IX,HEROES
COLLB0
        LD A,(IX)
        OR A
        jr Z,COLLBq
        LD HL,16<8+8
        CP IDapple
        jr C,COLLBn
        CP IDlog
        jr NC,COLLBn
       ;CP IDkey
       ;JZ COLLBid
       ;CP IDexit
       ;JZ COLLBid
       ;CP IDdiam
       ;JZ COLLBid
       ;CP IDdiam
       ;JZ COLLBid
       ;CP IDweight
       ;JZ COLLBid
       ;CP IDhourglass
       ;JNZ COLLBn
COLLBid
;все размеры - в двойных пикселях!
        LD A,L
COLLwdt=$+1
        ADD A,0 ;herowdt
        LD LY,A
        LD A,H
        LD HY,A
;коллизия,если (abs(X-Xb)<LY)and( (Y-Yb<herohgt*2)or(Yb-Y<HY) )
;abs(X-Xb)<LY?
        LD L,(IX+4) ;
        LD H,(IX+5) ;Xb
        XOR A
        SBC HL,DE ;Xb-X
        jr NC,COLLBx1
        SUB L
        LD L,A
        SBC A,A
        SUB H
        LD H,A
COLLBx1
        INC H
        DEC H
        jr NZ,COLLBn
        LD A,L
        CP LY ;monsterwdt+herowdt
        jr NC,COLLBn
;Yb-Y<HY?
        LD L,(IX+2) ;
        LD H,(IX+3) ;Yb
        XOR A
        SBC HL,BC ;Yb-Y
        INC H
        DEC H
        jr NZ,COLLBYn
        LD A,L
        CP HY ;monsterhgt*2
        jr C,COLLBy
COLLBYn
;Y-Yb<herohgt*2?
        XOR A
        SUB L
        LD L,A
        SBC A,A
        SUB H
        LD H,A    ;HL=Y-Yb
        INC H
        DEC H
        jr NZ,COLLBn
        LD A,L
COLLhgt2=$+1
        CP 0 ;herohgt*2
        jr C,COLLBy
COLLBn
        PUSH BC
        LD BC,Lunit
        ADD IX,BC
        POP BC
        JR COLLB0

BONCOLL
;проверка коллизии с героем
;IN: A=-HGTbonus
;OUT:CY=коллизия
        LD HL,(HEROES+2) ;Yhero
        OR A
        SBC HL,BC ;Yhero-Y = -HGTbonus...+HGThero
       INC H
       jr NZ,BONCOLLnU
        CP L
        RET NC
       DEC H
        JR BONCOLLyU
BONCOLLnU
        OR A
       DEC H
        RET NZ
        LD A,L
        CP 48 ;herohgt*2
        RET NC
BONCOLLyU
        LD HL,(HEROES+4) ;Xhero
        OR A
        SBC HL,DE ;Xhero-X
        JP P,BONCOLnNEG
        XOR A
        SUB L
        LD L,A
        SBC A,A
        SUB H
        LD H,A
BONCOLnNEG
        LD A,H
        OR A
        RET NZ
        LD A,L
        CP 24+24 ;herowdt+bonuswdt
        RET 

;управление героем
CPlrf
bottletime=$+1
        LD HL,0
        DEC HL
       LD A,H
       OR L
       LD A,fxbottleend
       CALL Z,AFXPRAY
        BIT 7,H
       LD A,(IX+6) ;dY
        jr NZ,_CPnbt ;NZ=не bottle
        LD (bottletime),HL
        LD A,(MKEY)
        LD L,A
        AND #30
        CP #30
        LD A,L
        jr Z,$+4
        XOR #30
        LD (MKEY),A
_CPnbt
bouncedX=$+1
       LD A,-1
       RLA 
       jr NC,hstrlwall ;можно отскакивать об стену
       LD A,(bouncedY)
      ;RLA
      ;jr C,hstyr ;в воздухе не разгоняем и не тормозим
                ;4 фрейма после контакта можно менять X
       CPL 
       AND #F0
       jr Z,hstyr
    ;для 50Hz работает только каждый 2-й фрейм
     LD A,(cycler)
     RRA 
     jr C,hstyr
hstrlwall
        LD A,(MKEY)
        BIT 5,A
        jr NZ,hstnl
;если нажали влево
       IF 0
        LD A,IDhero
        CP (IX)
        jr Z,hstylV
       ;LD (IX),A
       ;LD (IX+1),0
        LD (IX+10),0 ;time
hstylV
       ENDIF 
        LD A,(IX+7)
        DEC A
        CP -16 ;знакоместо/фрейм
        JP M,hstyr
        LD (IX+7),A;-4 ;speed
        JR hstyr
hstnl ;
        LD A,(MKEY)
        BIT 4,A
        jr NZ,hstnr
;если нажали вправо
       IF 0
        LD A,IDhero
        CP (IX)
        jr Z,hstyrV
       ;LD (IX),A
       ;LD (IX+1),0
        LD (IX+10),0 ;time
hstyrV
       ENDIF 
        LD A,(IX+7)
        INC A
        CP 16 ;знакоместо/фрейм
        JP P,hstyr
        LD (IX+7),A;4 ;speed
        JR hstyr
hstnr ;
;если отпущены влево и вправо, то тормозим dX
       ;LD (IX),IDherost
       ;LD (IX+1),0
        LD A,(IX+7)
        OR A
        jr Z,hstyr
        LD A,1
        JP M,$+5
        NEG 
        ADD A,(IX+7)
        LD (IX+7),A
hstyr ;
weighttime=$+1
        LD HL,0
        DEC HL
       LD A,H
       OR L
       LD A,fxgiryaend
       CALL Z,AFXPRAY
        BIT 7,H
        LD (weighttime),HL
        jr Z,hstnf
        INC HL
        LD (weighttime),HL
;если нажали fire на земле, то прыгаем (dec dY)
        LD A,(MKEY)
        BIT 0,A
        jr NZ,hstnf
       ;LD (IX),IDherof
       ;LD (IX+1),1
    ;проверка земли
bouncedY=$+1
       LD A,-1
       RLA 
       jr C,hstnf
       LD A,(IX+6) ;dY
     ;только если идет вверх после отскока
      DEC A
      JP P,hstnf
       SUB 10
        JP P,hstnf
        CP -21
        jr NC,$+3
        LD A,-21
       LD (IX+6),A
       ;LD (IX+7),0
       ;LD (IX+10),1 ;time
     ; LD A,fxjump
     ; CALL AFXPRAY
hstnf ;
hstndie
        RET 
GETdX
        LD L,(IX+7) ;speedX
        LD A,L
        RLA 
        SBC A,A
        LD H,A
        RET 
GETdY
        LD L,(IX+6) ;speedY
        LD A,L
        RLA 
        SBC A,A
        LD H,A
        RET 
YplusdY
        PUSH HL
        ADD HL,BC
        LD B,H
        ld C,L
        POP HL
        RET 
XplusdX
        PUSH HL
        ADD HL,DE
        EXD 
        POP HL
        RET 
       IF 0
CPpol
;NC=пересекли пол
        LD A,B
        SUB polY/256
        RET C
        RET NZ
        LD A,C
        CP polY
        RET 
CPpotol
;C=пересекли потолок
        LD A,B
        OR A
        RET NZ
       ;CALL GETbubHGT
       LD A,24*2
        SUB C
        NEG ;A=Y-hgt
        CP potolY
        RET 
GETbubHGT
;считаем высоту персонажа
       PUSH HL
        LD L,0
        LD A,(IX)
        CP IDbub32
        JNZ $+4
        LD L,32*2
        CP IDbub16
        JNZ $+4
        LD L,16*2
        CP IDbub8
        JNZ $+4
        LD L,8*2
        CP IDharp
        JNZ $+4
        LD L,18*2
        LD A,L
       POP HL
        RET 
       ENDIF 
BOUNCE
       LD A,-1
       LD (bouncedX),A
       LD A,(bouncedY)
       SCF 
       RRA 
       LD (bouncedY),A ;нельзя объединять,а то лезет по стене
        CALL GETdY ;HL=dY
     ;LD A,(timer)
     ;AND 3
     ;JNZ $+3
       INC HL ;гравитация
        CALL YplusdY

        BIT 7,L
        jr NZ,IQCPPOT
       CALL DETPOL
      jr C,IQNJY
   ;ломаем пол (A=номер плитки)
       ;INC L
        DEC L
        jr Z,IQnelom
      PUSH BC,DE
        CALL BOUNCEGETTYPE
       CP IDdoska
       jr NZ,IQpopnelom
       LD (HL),IDdoskabrk
        CALL dEBMAPP
        XOR A
        CALL dEBMALU
       IF fx
        LD A,fxcrack
        CALL AFXPRAY
       ENDIF 
IQpopnelom
      POP DE,BC
IQnelom

      ;JZ IQyNIZ
      ; CALL CPpol
      ; JC IQNJY
      ; LD BC,polY
      ; JR IQypol
IQyNIZ
        LD A,C
        AND #F0
        LD C,A
IQypol
       XOR A
       LD (bouncedY),A
        LD A,LY
        LD L,A
        JR IQNJY
IQCPPOT
       CALL DETPOTOL
      jr C,IQNPOT
        PUSH DE,HL
        CALL BOUNCEGETTYPE
        POP HL,DE
      ;JNC IQyWERH
      ;  CALL CPpotol
      ;  JNC IQNPOT
;IQyWERH
        LD C,(IX+2)
        LD B,(IX+3)
       ;LD A,C
       ;OR #F
       ;LD C,A
IQypotol
        XOR A
       LD (bouncedY),A
        SUB L
        LD L,A
IQNPOT
IQNJY
        LD (IX+6),L
        LD (IX+2),C ;Y
        LD (IX+3),B ;
        CALL GETdX
        CALL XplusdX
    ;если по X нулевая скорость, то отбросить от препятствия
       LD A,L
       OR A
       jr NZ,IQXn0
       CALL DETPRVO
        jr C,IQX0nP
IQX0yP  DEC L
        JR IQNJX
IQX0nP
       CALL DETLEVO
        jr C,IQX0nL
IQX0yL  INC L
IQX0nL  JR IQNJX
IQXn0
        BIT 7,L
        jr NZ,IQVLEVO
      CALL DETLEVO ;препятствие там, ОТКУДА мы - разгон
      jr NC,IQX0yL
       CALL DETPRVO
      ;JNC IQYJX
      ; LD A,D
      ; CP 2
        JR C,IQNJX
        JR IQYJXBRK
IQVLEVO
      CALL DETPRVO ;препятствие там, ОТКУДА мы - разгон
      jr NC,IQX0yP
       CALL DETLEVO
      JR C,IQNJX
      ;JNC IQYJX
      ; BIT 7,D
      ; JR Z,IQNJX
IQYJXBRK
   ;ломаем стекло (A=номер плитки)
      PUSH BC
     PUSH HL
        CALL BOUNCEGETTYPE
       CP IDglassV
       jr NZ,IQpopnelomV
        LD A,(IX+7) ;dX
        OR A
        JP P,$+5
        NEG 
        CP 15
        jr C,IQpopnelomV
       LD (HL),IDglassVbr
        CALL dEBMAPP
        XOR A
        CALL dEBMAVU
       IF fx
        LD A,fxglassbreak
        CALL AFXPRAY
       ENDIF 
IQpopnelomV
IQnelomV
     POP HL
      POP    BC
IQYJX   LD E,(IX+4)
        LD D,(IX+5)
        XOR A
       LD (bouncedX),A
        SUB L
        LD L,A
IQNJX   LD (IX+7),L
        LD (IX+4),E ;X
        LD (IX+5),D ;
       LD A,(bouncedX)
       RLA 
        LD A,(IX+7) ;dX
       jr NC,SNDBOUNCE
       LD A,(bouncedY)
       RLA 
       RET C
       LD A,(IX+6) ;dY
       OR A
       RET Z
SNDBOUNCE
   ;громкость=f(скорость)
        OR A
        JP P,$+5
        NEG 
        CP 15 ;зашкал уберет только IMER
        jr C,$+4
        LD A,15
        LD HL,tvolspd
        ADD A,L
        LD L,A
        ADC A,H
        SUB L
        LD H,A
        LD A,(HL)
       PUSH DE
       IF fx
       PUSH BC
        SUB 12
        LD C,A
BOUNCESOUNDTYPE=$+1
        LD A,0
        CP IDglassV
        jr Z,BSOUGL
        CP IDbeton
        jr Z,$+4
        CP IDbetonV
        LD A,fxbeton
        jr Z,BSOUOK
        LD A,fxderewo
        JR BSOUOK
BSOUGL  LD A,fxglass
BSOUOK  CALL AFXPRAYVOL
       POP BC
       ELSE 
        LD DE,BSG
        CALL NEWSAMPVOL
       ENDIF 
       POP DE
        RET 
tvolspd
        db 0x09,0x09,0x09,0x0A,0x0A,0x0A,0x0B,0x0B,0x0C,0x0C,0x0C,0x0D,0x0D,0x0E,0x0E,0x0E
BOUNCEGETTYPE
      LD L,A
      LD H,0
      LD E,L
      ld D,H
      ADD HL,HL
      add HL,HL ;*4
      ADD HL,DE       ;*5
      ADD HL,HL
      add HL,DE ;*11
      LD DE,HEROES
      ADD HL,DE
       LD A,(HL)
      LD (BOUNCESOUNDTYPE),A
        RET 

LISTEND
;ищем конец списка персонажей
        PUSH BC
        PUSH IX
        POP HL
        XOR A
        LD BC,Lunit
        ADD HL,BC
        CP (HL)
        jr NZ,$-2
        POP BC
        RET 

_ARR_L
        LD A,(IX+10) ;time
        ADD A,16
        LD (IX+10),A
        LD HL,2
        JP P,$+6
        LD HL,-2
        ADD HL,DE
        LD (IX+4),L
        LD (IX+5),H ;X
        JP programQ
_ARU_D
        LD A,(IX+10) ;time
        ADD A,16
        LD (IX+10),A
        LD HL,2
        JP P,$+6
        LD HL,-2
        ADD HL,BC
        LD (IX+2),L
        LD (IX+3),H ;Y
        JP programQ

_SPIDER
        LD A,(IX+8) ;energy
        ADD A,1
        LD (IX+8),A
        LD HL,2
        JP P,$+6
        LD HL,-2
        ADD HL,BC
        LD (IX+2),L
        LD (IX+3),H ;Y
        LD A,-24 ;-HGTпаука
        CALL BONCOLL
        JP NC,programQ
       IF fx
SJEDEN=$
       OR A ;55=не съеден
        LD A,fxekill
        CALL C,AFXPRAY
        LD A,55+128
        LD (SJEDEN),A
       ENDIF 
        LD A,1 ;lost
        LD (gameover),A
        JP programQ


_HERO
        LD A,(IX+6) ;dY
        CPL 
        ADD A,4;2
        JP M,$+4
        XOR A
        LD LY,A;-0
        LD A,B
        SUB dieY/256
       jr C,_HEROnfdll
       jr NZ,_HEROnfdll
        LD A,C
        CP dieY&0xff
       jr C,_HEROnfdll
        LD A,1 ;lost
        LD (gameover),A
_HEROnfdll
        LD A,B
        SUB fallY/256
       jr C,_HEROnfall
       jr NZ,_HEROnfall
        LD A,C
        CP fallY&0xff
       jr C,_HEROnfall
        PUSH DE
        LD HL,(falladd)
        LD DE,16
        ADD HL,DE
        LD (falladd),HL
        EXD 
        ADD HL,BC
        LD B,H
        ld C,L
        LD (IX+2),C
        LD (IX+3),B ;Y
       IF fx
UPAL=$
       OR A ;55=не падал
        LD A,fxfall
        CALL C,AFXPRAY
        LD A,55+128
        LD (UPAL),A
       ENDIF 
        POP DE
        JR $+5 ;пропуск BOUNCE
_HEROnfall
        CALL BOUNCE ;ставит флаг касания
        CALL CPlrf
   ;взяли бонус/напоролись на врага?
       CALL DETBON_ENEMY
      ;01-враг (?)
      ;10-бонус
       PUSH DE
        CP %10
        CALL Z,_HEROBONPP
       POP DE
        LD C,(IX+4) ;X
  ;фаза=X*0.2122~=(X-X/8)/4
        LD A,(IX+5) ;'X
        RRA 
        LD A,C
        RRA 
        RRA 
        RRA 
        SUB C
        RRA 
        RRA 
        AND 15
        LD (IX+1),A
_EMPTY  JP programQ
_HEROBONPP
     ;ищем этот бонус в списке
       LD HL,#3018 ;размеры персонажа в полупикселях (hgt, бок)
       CALL COLLBALL ;коллизии ;CY=коллизия
        RET NC
      ;HL=адрес приза
        LD A,(HL)
        CP IDweight
       JP Z,_HEROWGT
        CP IDbottle
       JP Z,_HEROBOT
        CP IDexit
       JP Z,_HEROEXIT
        CP IDapple
       jr Z,_HEROapp
        CP IDhourglass
       JP Z,_HEROHG
        CP IDdiam
       JP Z,_HERODIAM
        CP IDkey
       JP Z,_HEROKEY
        RET 
_HEROapp
        LD (HL),ID15
        LD DE,15
       PUSH DE
        LD DE,10
        ADD HL,DE ;time8
        LD (HL),50
       IF fx
        LD A,fxfood
        CALL AFXPRAY
       ELSE 
        LD DE,BBONUS
        CALL NEWSAMP
       ENDIF 
_HINCSC POP HL
        JP INCSCORE
_HEROKEY
        LD (HL),ID5
        LD DE,5
       PUSH DE
        LD A,(keys)
        DEC A
        LD (keys),A
        call INVALIDATEKEYS
        LD DE,10
        ADD HL,DE ;time8
        LD (HL),50
       IF fx
        LD A,(keys)
        OR A
        LD A,fxkeylast
        jr Z,$+4
        LD A,fxkey
        CALL AFXPRAY
       ELSE 
        LD DE,BBONUS
        CALL NEWSAMP
       ENDIF 
        JP _HINCSC
_HERODIAM
        LD (HL),ID25
        LD DE,25
       PUSH DE
        LD DE,10
        ADD HL,DE ;time8
        LD (HL),50
       IF fx
        LD A,fxbonus2
        CALL AFXPRAY
       ENDIF 
        JP _HINCSC
_HEROBOT
        LD (HL),IDerased
       IF fx
        LD A,fxbottle
        CALL AFXPRAY
       ELSE 
        LD DE,BRIF
        CALL NEWSAMP
       ENDIF 
        LD HL,50*20
        LD (bottletime),HL
        RET 
_HEROEXIT
        INC HL
        XOR A
        OR (HL)
        RET Z
        LD (HL),A
        DEC HL
        LD (HL),IDerased
       IF fx
       ;LD A,fxwin
       ;CALL AFXPRAY
       ELSE 
        LD DE,BRL
        CALL NEWSAMP
       ENDIF 
        LD A,2 ;won
        LD (gameover),A
        RET 
_HEROWGT
        LD (HL),IDerased
       IF fx
        LD A,fxgirya
        CALL AFXPRAY
       ELSE 
        LD DE,BRIF
        CALL NEWSAMP
       ENDIF 
        LD HL,50*20
        LD (weighttime),HL
        RET 
_HEROHG
        LD (HL),IDerased
       IF fx
        LD A,fxbonus1
        CALL AFXPRAY
       ENDIF 
        LD HL,TTIME2+1
        LD A,(HL)
        ADD A,2 ;+20 секунд
        LD (HL),A
        CP "9"+1
        jr C,HGLOK
        SUB 10
        LD (HL),A
        DEC HL
        INC (HL) ;больше 100 с никогда не будет
HGLOK   PUSH IX
        CALL PRCLK
        POP IX
        RET 
       IF 0
_HEROdie
        LD LY,-2
        CALL BOUNCE
        LD HL,#000 ;1 фаза
        CALL PHASER
        JP P,programQ
        LD A,1
        LD (gameover),A
        JP programQ

_HEROwin
        LD LY,-3
        CALL BOUNCE
        LD HL,#000 ;1 фаза
        CALL PHASER
        JP P,programQ
        LD A,2
        LD (gameover),A
       ENDIF 
programQ
        LD BC,Lunit
        ADD IX,BC
        JP IQ

_NUMBER
        DEC BC
        DEC BC
        LD (IX+2),C
        LD (IX+3),B
        DEC (IX+10)
        CALL Z,DELPERS
        JP programQ

_EXIT
        LD A,(keys)
        OR A
        jr NZ,_EXITnK0
        LD (IX+1),1 ;было 0=sprempty
_EXITnK0
        JP programQ

DELprogQ_
        CALL DELPERS
        JP IQ
MOVEANIM
;двигаем синхронные анимации
DIAMtime=$+1
        LD A,1
DIAMHL=$+1
        LD HL,DIAMANI
        LD DE,DIAMFIG
        CALL DIAMTIME
        LD (DIAMtime),A
        LD (DIAMHL),HL
EXITtime=$+1
        LD A,1
EXITHL=$+1
        LD HL,EXITANI
        LD DE,EXITFIG
        CALL DIAMTIME
        LD (EXITtime),A
        LD (EXITHL),HL
KEYtime=$+1
        LD A,1
KEYHL=$+1
        LD HL,KEYANI
        LD DE,KEYFIG
        CALL DIAMTIME
        LD (KEYtime),A
        LD (KEYHL),HL
WGTtime=$+1
        LD A,1
WGTHL=$+1
        LD HL,WGTANI
        LD DE,WGTFIG
        CALL DIAMTIME
        LD (WGTtime),A
        LD (WGTHL),HL
BOTtime=$+1
        LD A,1
BOTHL=$+1
        LD HL,BOTANI
        LD DE,BOTFIG
        CALL DIAMTIME
        LD (BOTtime),A
        LD (BOTHL),HL
SPItime=$+1
        LD A,1
SPIHL=$+1
        LD HL,SPIANI
        LD DE,SPIFIG
        CALL DIAMTIME
        LD (SPItime),A
        LD (SPIHL),HL
CHEtime=$+1
        LD A,1
CHEHL=$+1
        LD HL,CHEANI
        LD DE,CHEFIG
        CALL DIAMTIME
        LD (CHEtime),A
        LD (CHEHL),HL
HOURtime=$+1
        LD A,1
HOURHL=$+1
        LD HL,HOURANI
        LD DE,HOURFIG
        CALL DIAMTIME
        LD (HOURtime),A
        LD (HOURHL),HL
        RET 
DIAMTIME
        DEC A
        RET NZ
        OR (HL)
        INC HL
        jr NZ,DIAMnBE
        LD A,(HL)
        INC HL
        LD H,(HL),L,A
        LD A,(HL)
        INC HL
DIAMnBE LDI 
        LDI 
        RET 
DIAMANI
        DB 15
        DW diam1
        DB 3
        DW diam3
        DB 0       ;
        DW DIAMANI ;конец анимации
HOURANI
        DB 3
        DW sand1
        DB 3
        DW sand2
        DB 3
        DW sand3
        DB 3
        DW sand4
        DB 3
        DW sand5
        DB 3
        DW sand6
        DB 3
        DW sand7
        DB 3
        DW sand8
        DB 0       ;
        DW HOURANI ;конец анимации
EXITANI
        DB 4
        DW exit1
        DB 4
        DW exit2
        DB 4
        DW exit3
        DB 4
        DW exit4
        DB 0       ;
        DW EXITANI ;конец анимации
WGTANI
        DB 8
        DW weight1
        DB 4
        DW weight2
        DB 8
        DW weight1
        DB 4
        DW weight3
        DB 0
        DW WGTANI
SPIANI
        DB 4
        DW spi1
        DB 4
        DW spi2
        DB 4
        DW spi3
        DB 4
        DW spi4
        DB 4
        DW spi5
        DB 4
        DW spi6
        DB 4
        DW spi7
        DB 4
        DW spi8
        DB 0
        DW SPIANI
BOTANI
        DB 4
        DW bottle1
        DB 4
        DW bottle2
        DB 4
        DW bottle3
        DB 4
        DW bottle4
        DB 4
        DW bottle5
        DB 4
        DW bottle4
        DB 4
        DW bottle3
        DB 4
        DW bottle2
        DB 0
        DW BOTANI
KEYANI
        DB 4
        DW key1
        DB 4
        DW key2
        DB 4
        DW key3
        DB 4
        DW key4
        DB 4
        DW key5
        DB 4
        DW key6
        DB 0       ;
        DW KEYANI ;конец анимации
CHEANI
        DB 11
        DW ch1
        DB 9
        DW ch2
        DB 5
        DW ch3
        DB 7
        DW ch4
        DB 11
        DW ch5
        DB 7
        DW ch4
        DB 5
        DW ch3
        DB 9
        DW ch2
        DB 0       ;
        DW CHEANI ;конец анимации
