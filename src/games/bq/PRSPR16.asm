        ;MAIN "*",#C6
        MACRO D31
     ;досюда было LD A,D:DEC D:AND 31:JNZ обход
        ;LOCAL 
        LD A,D ;#FF/#1F->#D8/F8   #BF->4
        INC A  ;#00/#20->#D8/F8   #C0->4
        CP 64
        LD D,4 ;спрайты не выше 32 пикс., 40*32=#500
        jr NC,$+5;QPRSPRni
        ADD A,#D8
        LD D,A
;QPRSPRni
        ;ENDL 
        ENDM 
;процедуры работы с экраном

;генератор таблицы маски для спрайтов
;%RLRRRLLL
;маска=0
;если L=0, то маска|=%01000111
;если R=0, то маска|=%10111000
MKMASK
       IF msx==0
WHERETMASK1=$+2
        LD HL,TMASK
MKMASK0 LD A,L
        LD C,%01000111
        AND C
        jr Z,$+4
        LD C,0
        XOR L
        LD A,C
        jr NZ,$+4
        OR %10111000
        LD (HL),A
        INC L
        JR NZ,MKMASK0
;TNXTLN = табл. старшего байта адреса экрана Y=L*8, X=(L/64)*2
   ;с L&#E0+SCRHGT начинаются нули
        LD HL,TNXTLN
MKTIH0
      IF atm==0
        LD DE,#C700
MKTIH1
        LD (HL),D
      ELSE 
        LD (HL),#DF
      ENDIF 
        BIT 7,L
        jr Z,$+4
        SET 5,(HL)
       LD A,L
       AND 31
       CP scrhgt/8 ;SCRHGT ;высота
      IF atm
        LD A,(HL)
        jr C,$+4
        AND #20
        OR #1F
        LD (HL),A
      ELSE 
       jr C,$+4
       LD (HL),7
        LD A,E
        ADD A,32
        LD E,A
        jr NC,$+6
        LD A,D
        ADD A,8
        LD D,A
      ENDIF 
        INC L
      IF atm==0
        LD A,L
        AND 31
        jr NZ,MKTIH1
        LD A,L
        OR A
      ENDIF 
        jr NZ,MKTIH0
       ENDIF ;~msx
        RET 

;перекодировщик из координат персонажей в коорд-ты спрайтов
;вход:             выход:
    ;ID
    ;phase
;ног;Y16 (в 1/2 пикс)  pgsprite
;ось;X16 (в 1/2 пикс)  addrsprite
    ;speedY
    ;speedX
    ;energy16          Y на экране (ног)
    ;time8             X/2 на экране (ось)
;в конце 0         в конце -1
HEROcopy
        DS Lunit
        NOP ;конец списка
PersToSprs
        LD HL,HEROES
        LD DE,HEROcopy
        LD BC,Lunit
        LDIR ;защита от изменения коорд героя
   ;todo снаружи
       IF msx
        LD HL,256-potolY+96 +48
       ELSE 
        LD HL,256-potolY+96 +112
       ENDIF 
falladd=$+1
       LD DE,0
       ADD HL,DE
      ADD HL,DE
        LD DE,(HEROcopy+2) ;Y коорд. героя
       LD B,D
       ld C,E
       DUP 2
       SRA B
       RR C
       EDUP ;Y/4
      IF msx
      SRA B
      RR C
      ENDIF 
       EXD 
       ADD HL,BC ;SBC?
       EXD ;Y*5/4
        OR A
        SBC HL,DE
        LD (PersSYm),HL
        LD DE,(HEROcopy+4) ;X коорд. героя
       LD B,D,C,E
       DUP 2
       SRA B
       RR C
       EDUP 
       EXD 
       ADD HL,BC ;SBC?
       EXD 
        LD HL,256-0+128 +128
        OR A
        SBC HL,DE
        LD (PersSXm),HL
PersLDIR
        ;LD A,(timer)
        ;PUSH AF
        LD HL,SPRS
        EXX 
       LD HL,HEROES+Lunit ;героя оставляем напоследок
        LD HX,TPERSTYPE/256
        CALL PersL0
       LD HL,HEROcopy ;герой
       LD A,(HL)
       CALL PersLRY
   ;если во время копирования произошло прерыв-е, то 2-я попытка
        ;POP BC
        ;LD A,(timer)
        ;CP B
        ;JNZ PersLDIR
        EXX 
        LD (HL),-1 ;конец
        INC HL
        RET 
PersLi8
        LD BC,8
        ADD HL,BC
PersL0
        XOR A
        OR (HL)
PersLRT RET Z
PersLRY LD LX,A   ;ID
        INC HL
        LD A,(HL) ;phase
        EXA 
        INC HL
      ;проверка на попадание в кадр
;дать признак обработчику прерыв-й? (в ID или в phase?)
        LD C,(HL) ;Y*2
        INC HL    ;
        LD B,(HL) ;
       EXD 
PersSYm=$+1
   ;scrhgt=160
   ;т.е.до вычитания HL=(96..255)*2
        LD HL,-potolY+96 ;(-Y*2 экрана)+96
        ADD HL,BC
        LD A,H
        CP 2
       EXD 
        jr NC,PersLi8
        LD A,E
        SRL D
        RRA 
              ;32=макс.глубина спрайта под горизонтом
              ;и отсекать по высоте (todo ее в таблицы)
;16 для призов, 32 для verwall (LX>=IDlogV)
;24 для монстра (LX=IDspi)
        SUB 96-32;16
       jr C,PersLi8 ;в PANG не было
    ;сейчас зашкал под пол max 31
        EXX 
        LD B,A
        EXX 
    IF 0 ;точное отсечение плохих Y теперь в PrSpr
      CP 160+16 ;зашкал под пол >=16?
      jr C,PersNV
     CP 160+24 ;зашкал >=24?
      LD A,LX
     jr NC,Pers24
    ;зашкал 16..24 - можно выводить монстра
     CP IDspi
     jr Z,PersNV
Pers24
      CP IDlogV
      jr C,PersLi8 ;если >=16 и не верт.стена,то не рисуем
PersNV
    ENDIF 
        INC HL
        LD C,(HL) ;X*2
        INC HL    ;
        LD B,(HL) ;
       EXD 
PersSXm=$+1
        LD HL,-0+128 ;(-X*2 экрана)+128
        ADD HL,BC
        LD A,H
        CP 3
       EXD 
        jr NC,PersLi6
       PUSH HL
        LD A,E
        SRL D
        RRA 
        SRL D
        RRA ;получили коорд-ты с точн. в 2 пикс.
        SUB 128/4
        EXX 
        LD C,A
        EXX 
        LD L,(IX+2)
        LD H,(IX+3) ;адрес таблицы фаз этого персонажа
        EXA       ;phase
        ADD A,A
        INC A
        LD C,A,B,0
        LD A,(HL) ;A=pg
        ADD HL,BC ;HL=где адрес нужного спрайта (фазы)
        LD E,(HL)
        INC HL
        LD D,(HL) ;DE=адрес спрайта
       PUSH DE
        EXX 
  ;pgsprite
        LD (HL),A
        INC HL
  ;addrsprite
       POP DE
        LD (HL),E
        INC HL
        LD (HL),D
        INC HL
  ;Y на экране
        LD (HL),B
        INC HL
  ;X/2 на экране
        LD (HL),C
        INC HL
        EXX 
       POP HL
PersLi6
        LD BC,6
        ADD HL,BC
        JP PersL0

;DVIG
;выводилка спрайтов по таблице (HL)
  ;pgsprite
  ;addrsprite
  ;Y на экране (ног)
  ;X/2 на экране
;HL' = адрес, куда запоминать параметры кусков экрана
PrSprs

        call setpgsscr40008000     

	call PrSprs_pp

        call setpgsmain40008000     
        
        exx
        ld (hl),-1
        ret

;;;;;;;;;;;;;;;;;;;;;;;;;;;;;;;
PrSprs_pp
        ;LD A,(curscr)
        ;AND 8
       ;LD (prevcopied+1),A ;при старте уровня в SPROUTBUF каша
PrSprs0
        LD A,(HL) ;страница спрайта
        OR A
        RET M
        INC HL
        CALL OUTA
        LD E,(HL)
        INC HL
        LD D,(HL) ;адрес спрайта
        INC HL
       push de
       pop iy
;x: 16c sprite: wid/2,hgt,(column:and,or...),(0x4000-((hgt-1)*40))...,prsprqwid
       LD c,(iy-4) ;width/2
       ld lx,c
       LD a,(iy-3) ;height
       LD hx,A
        LD B,(HL) ;Y низа на экране (>=0?)
        INC HL
        LD A,(HL) ;X/2 на экране
        SRL C ;width/4
        SUB C ;из X/2 оси перса получаем X/2 левого края перса
        LD C,A
        INC HL
  ;не печатать, если Xлев/2 и Xлев/2+width/2 оба <0
   JP P,PrSprNMX
   ADD A,lx ;width/2
   JP M,PrSprs0
PrSprNMX
 if 1
  ;не печатать, если Y и Y-height оба >=SCRHGT*8
   LD A,B ;y низа (включительно)
   CP scrhgt ;SCRHGT*8
   jr c,PrSprNMY ;y низа (включительно) в пределах экрана
   inc a ;y низа (невключительно)
   SUB hx ;hgt
   CP scrhgt ;SCRHGT*8
   jr nc,PrSprs0 ;y не в пределах экрана
PrSprNMY
 endif
;de=адрес, откуда берем данные спрайта
;c=X/2 левого края спрайта
;b=Y на экране
       ld a,c
       add a,sprmaxwid-1
       ld e,a ;x/2 (кодируется как x+(sprmaxwid-1))
  if 1
       ld a,c
       jr nc,$+3
       xor a
       exx
        ld (hl),a ;x/2 в пределах экрана
       inc hl
       add a,lx ;width/2
   cp scrwid
   jr c,$+4
   ld a,scrwid
        ld (hl),a ;xright/2 (невключительно) в пределах экрана
       inc hl       
       exx
  endif
       ld a,b ;y низа (включительно)
       inc a ;y низа (невключительно)
       sub hx ;hgt
       ld c,a ;y
  if 1       
       jr nc,$+3
       xor a
       exx
        ld (hl),a ;y верха в пределах экрана
       inc hl
       add a,hx ;hgt
   cp scrhgt ;SCRHGT*8
   jr c,$+4
   ld a,scrhgt ;SCRHGT*8
        ld (hl),a ;ybottom (невключительно) в пределах экрана
       inc hl
       exx
  endif
;e=x = -(sprmaxwid-1)..159 (кодируется как x+(sprmaxwid-1))
;c=y = -(sprmaxhgt-1)..199 (кодируется как есть)

       PUSH HL
        call prspr ;не использует exx
       POP HL
        JP PrSprs0 ;следующий спрайт

;восстановилка экрана под спрайтами
;HL' = адрес, куда запоминали параметры кусков экрана
;x/2, xright/2 невключительно, y, ybottom невключительно
;-1 = end
ReSprs
        call setpgsscr40008000
        ld a,(tpgscrdata) ;TODO
        SETPGC000
ReSprs0
        exx
        ld a,(hl) ;x/2
        cp -1
        jp z,setpgsmain40008000 ;exit
        inc hl
        exx
        srl a
        srl a
        ld c,a ;x/8
        exx
        ld a,(hl) ;xright/2
        add a,3
        inc hl
        exx
        srl a
        srl a
        sub c
        ld e,a ;wid/8
        exx
        ld a,(hl)
        inc hl
        exx
        ld b,a ;y
        exx
        ld a,(hl)
        inc hl
        exx
        sub b
        ld d,a ;hgt
        ;jr z,$
;b=y
;c=x/8
;d=hgt
;e=wid/8
        ld a,c ;x/8
        ld c,b ;y
        ld b,0
        ld h,b
        ld l,c ;y
        add hl,hl
        add hl,hl
        add hl,bc ;y*5
        add hl,hl
        add hl,hl
        add hl,hl ;y*40
        ld c,a ;x/8
        add hl,bc
        ld bc,scrbase
        add hl,bc
        call copyimgega_defaulttoshadow
        jp ReSprs0

copyboxega
        ;ret
;b=hgt,c=wid (/2)
;hl=scr (пересчитывается в 0xc000+ -> 0x8000+)
copyboxega0
        push bc
        ld hx,b
        push hl
        ld bc,40;+0x4000
copyboxcolumn0
       push hl
       set 7,h
       set 6,h
        ld a,(hl)
        ;res 6,h
       pop hl
        ld (hl),a
        add hl,bc
        dec hx
        jr nz,copyboxcolumn0
        pop hl
        ld a,0x9f;0xa0
        cp h
        ld bc,0x4000
        adc hl,bc
        jp pe,copyboxegacolumn0q ;в половине случаев
;8000->с000 (надо 6000) или a000->e001 (надо 4001)
         inc a
        xor h
        ld h,a
copyboxegacolumn0q
        pop bc
        dec c
        jr nz,copyboxega0
        ret


CLSCRS
        ld de,emptypal
        OS_SETPAL ;включаем чёрную палитру, чтобы было незаметно переброску экрана
        halt
        ;LD A,8
        ;LD (curscr),A
        CALL OUTscr_high_cur
        CALL CLSC0E
        ;LD A,p14
        CALL OUTscr_low_cur
        ;LD H,#40
        ;CALL CLS16
        ;LD H,#60
        ;CALL CLS16
        CALL CLSC0E
        ;XOR A
        ;LD (curscr),A
;CL2ND_
;чистим 2-й экран при включенном 1-м
        ;LD A,p16
        call OUTscr_low
        CALL CLSC0E;0
        call OUTscr_high
        ;LD A,p17
;CLSC0E0
        ;CALL OUTA
        call CLSC0E
        ld de,pal
        OS_SETPAL ;включаем палитру
        ret
        
CLSC0E  LD H,#C0
        CALL CLS16
        LD H,#E0
CLS16
        LD D,H
        ld E,1
        ld L,0
        LD BC,7999
        LD (HL),L
        LDIR 
        RET 

SCR1toSCR2
        CALL OUTscr_low_cur
        LD H,#C0
        LD D,#A0
        CALL LDIR24
        CALL OUTscr_low
        LD H,#A0
        LD D,#C0
        CALL LDIR24
        CALL OUTscr_low_cur
        LD H,#E0
        LD D,#A0
        CALL LDIR24
        CALL OUTscr_low
        LD H,#A0
        LD D,#E0
        CALL LDIR24
        CALL OUTscr_high
        LD H,#40
        LD D,#C0
        CALL LDIR24
        LD H,#60
        LD D,#E0
LDIR24
        LD BC,8000
        LD L,0,E,L
        LDIR 
        RET 
        
DDE
       IF atm
        PUSH HL
        LD HL,40
        ADD HL,DE
        EXD 
        POP HL
        RET 
       ELSE 
        INC D
        LD A,D
        AND 7
        RET NZ
        LD A,E
        ADD A,32
        LD E,A
        RET C
        LD A,D
        SUB 8
        LD D,A
        RET 
       ENDIF 
;------------ дальше ламерство ------------------------
HALTER
        HALT 
        RET 
MEGAPRMASK
        LD (MPRMhscr),BC
        LD (MPRMlscr),DE
        LD B,A ;total symbols
        SRL A
        LD C,A ;# of 1st symbol to print
MEGAPRMASK0
       PUSH BC,HL
        CALL HALTER
MPRMhscr=$+1
        LD DE,0
        PUSH BC,HL
        LD A,B
        SUB C ;# of 1st nonprinted symbol
        SUB C
        LD B,A ;symbols to print
        CALL NZ,PRTXT88MC
        POP HL,BC
        LD A,L
        ADD A,B
        LD L,A
        jr NC,$+3
        INC H
MPRMlscr=$+1
        LD DE,0
        LD A,B
        SUB C ;# of 1st nonprinted symbol
        SUB C
        LD B,A ;symbols to print
        CALL NZ,PRTXT88MC
       POP HL,BC
        DEC C
        JP P,MEGAPRMASK0
        RET 
PRTXT88
;C=фоновый цвет (в виде атрибута)
        LD A,(HL)
        INC HL
        OR A
        RET Z
        CALL PR88
        JR PRTXT88

PRTXT88MC
        LD A,C
        OR A
        jr Z,PRTXT88M
PRTXT88MC0
        INC HL
        CALL PR88MASKQ
        DEC C
        jr NZ,PRTXT88MC0
PRTXT88M
        LD A,(HL)
        INC HL
        CALL PR88MASK
        DJNZ PRTXT88M
        RET 
       IF msx==0
PR88MASK
       PUSH BC,HL
        LD L,A
        LD A,pgpic
        CALL OUTA
        LD H,0
        ADD HL,HL
        add HL,HL
        add HL,HL
        ADD HL,HL
        add HL,HL
        LD A,H
        ADD A,tileset/256
        LD H,A
       PUSH DE
        LD DE,PROUTBUF
        LD BC,32
        LDIR 
       POP DE
        LD BC,PROUTBUF
;выводим на 2-й экран
       PUSH DE
        PUSH DE
         push bc
         ;LD A,p16
         CALL OUTscr_low_cur;16
         pop bc
        call CHMSTOLB
        POP DE
        PUSH DE
       ;RES 7,D
         push bc
         ;LD A,p17
         CALL OUTscr_high_cur;17
         pop bc
        call CHMSTOLB
        POP DE
        SET 5,D
        PUSH DE
         push bc
         ;LD A,p16
         CALL OUTscr_low_cur;16
         pop bc
        call CHMSTOLB
        POP DE
       ;RES 7,D
         push bc
         ;LD A,p17
         CALL OUTscr_high_cur;17
         pop bc
        call CHMSTOLB
       POP DE
       POP HL,BC
PR88MASKQ
        INC DE ;для ATM нельзя INC E
        RET 

PR88
       PUSH BC,HL
        CALL PR88PREP
;выводим на 1-й экран
       PUSH HL
       PUSH DE
        PUSH DE
        ;LD A,p14
        CALL OUTscr_low_cur
        call CHRSTOLB
        POP DE
        PUSH DE
        ;RES 7,D
        CALL OUTscr_high_cur
        CALL CHRSTOLB
        POP DE
        SET 5,D
        PUSH DE
        CALL OUTscr_low_cur
        CALL CHRSTOLB
        POP DE
        ;RES 7,D
        CALL OUTscr_high_cur
        CALL CHRSTOLB
       POP DE
       POP HL
;выводим на 2-й экран
       PUSH DE
       ;LD HL,PROUTBUF
        PUSH DE
        ;LD A,p16
        CALL OUTscr_low
        call CHRSTOLB
        POP DE
        PUSH DE
        ;LD A,p17
        CALL OUTscr_high
        call CHRSTOLB
        POP DE
        SET 5,D
        PUSH DE
        ;LD A,p16
        CALL OUTscr_low
        call CHRSTOLB
        POP DE
        ;LD A,p17
        CALL OUTscr_high
        call CHRSTOLB
       POP DE
       POP HL,BC
        INC DE ;для ATM нельзя INC E
        RET 
PR88PREP
      SUB 32
        LD L,A
        LD A,pgfnt
        CALL OUTA
        LD H,0
        ADD HL,HL,HL,HL,HL,HL
        ADD HL,HL,HL,HL
        LD A,H
        ADD A,f88/256
        LD H,A
       PUSH DE
      ;PUSH BC
        LD DE,PROUTBUF
        LD B,32
PR880
        LD A,(HL)
        LD ($+4),A
WHERETMASK2=$+2
        LD A,(TMASK)
        AND C
        OR (HL)
        LD (DE),A
        INC HL,DE
        DJNZ PR880
      ;POP BC
       POP DE
        LD HL,PROUTBUF
        RET 

;OUTCHRSTOLB
        ;CALL OUTA
CHRSTOLB
;HL=шрифт
;DE=экран
       IF atm
        PUSH BC
        LD BC,#828
cstid=$
        LD A,(HL)
        ld (DE),A
        INC L
        LD A,E
        ADD A,C
        LD E,A
        jr NC,$+3
        INC D
        DJNZ cstid
        POP BC
       ELSE 
        DUP 8
        LD A,(HL)
        ld (DE),A
        INC L
cstid=$
        INC D
        EDUP 
        ORG cstid
       ENDIF 
        RET 

;OUTCHMSTOLB
        ;CALL OUTA
CHMSTOLB
WHERETMASK3=$+1
        LD H,TMASK/256
       LD A,8
OCMST0 PUSH AF
       ;DUP 8
        LD A,(BC)
        INC C
        LD L,A
        LD A,(DE)
        AND (HL)
        OR L
        ld ($+4),a
        ld a,(tcol8tocol0)
        LD (DE),A
;cstid=$
       IF atm
        LD A,E
        ADD A,40
        LD E,A
        jr NC,$+3
        INC D
       ELSE 
        INC D
       ENDIF 
       ;EDUP
       POP AF
       DEC A
       jr NZ,OCMST0
       ;ORG cstid
        RET 
      ENDIF ;~msx
PRLIVES
_y=#B0
_x=1
        xy2adr
       IF msx
_a=136*3-160*128+_a
       ENDIF 
        LD DE,_a
        LD C,0
lives=$+1
        LD L,beglives
        LD B,2
PRLIV0  PUSH BC
       PUSH HL
        LD A,L
        CP B
        LD A," "
        jr C,$+4
        LD A,"^"
        CALL PR88
       POP HL
        POP BC
        INC B
        LD A,B
        CP maxlives+1
        jr NZ,PRLIV0
        RET 

PR12345
        LD BC,10000
        CALL PRDIG
        LD BC,1000
        CALL PRDIG
PR123
        LD BC,100
        CALL PRDIG
        LD BC,10
        CALL PRDIG
        LD BC,1
PRDIG   LD A,"0"-1
        OR A
        INC A
        SBC HL,BC
        jr NC,$-3
        ADD HL,BC
        LD C,0 ;фоновый цвет
        JP PR88
