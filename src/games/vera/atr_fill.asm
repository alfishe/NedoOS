;fill_atributes

ATTR    EQU 48+6;+64

        ORG #6000

        CALL  FILL

        CALL    WAITKEY
        LD HL,#4000
        LD DE,#4001
        LD BC,6911
        LDIR 
        JR #6000

;ждет нажатия на любую клавишу
WAITKEY
        XOR     A
        IN      A,(#FE)
        CPL 
        AND     #1F
        JR      Z,WAITKEY
        RET 

FILL
        LD A,6
        OUT (254),A

        LD BC,TABLE
fill_1
        LD HL,#581F
        LD A,(BC)
        AND A
        RET Z
;       INC BC
;       LD E,A
fill_2
        LD A,(BC)
        AND A
        JR Z,fill_4
        LD D,A
        LD A,L
fill_3
        LD (HL),ATTR
        DEC L
        DEC D
        JR NZ,fill_3
        ADD A,32
        LD L,A
        ADC A,H
        SUB L
        LD H,A
        INC BC
        JR fill_2
fill_4
        HALT   ;тут задержка до следующего кадра
        INC BC ;(главное - bc не портить!)
        JR fill_1

;таблица - последовательность кадров.
;конец кадра - 0
;конец таблицы - 255
;в каждом кадре указывается,
;сколько знакомест в строке заливать


TABLE
        DB 1,0,2,2,0,3,3,3
        DB 0,4,4,4,3,0,5,5
        DB 5,4,3,0,6,6,6,6
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        DB 32,0,255

TBLEND

        DISPLAY "Длина таблицы:",$-TABLE
