;prog=#C000
scrhgt=200;128
Ycenter=100
Ytop=Ycenter-(scrhgt/2)
Ybottom=Ycenter+(scrhgt/2)
scrbase=#4000+4
scrtop=Ytop*40+scrbase
addhlbc=1 ;можно scrhgt=200 и в одной странице
customscales=0;1

;генерируем:
       ;LD HL,<TOP>
       ;JNC $+4
       ;SET 5,H
       ;ADD A,L
       ;LD L,A
       ;JNC $+3
       ;INC H

;        ORG #6000
;tjp
;        DS 256

;        ORG #7000
;        DI 
genscalers
       IF customscales
        LD HL,tscales
        LD B,64
        LD DE,64
DeCust PUSH BC
        LD C,(HL)
        LD (HL),E
        INC HL
        LD B,(HL)
        LD (HL),D
        INC HL
        EXD 
        ADD HL,BC
        EXD 
       POP BC
        DJNZ DeCust
       ENDIF ;customscales

        LD IY,tscaljps;tjp
        LD HL,0xc000;prog
        LD DE,tscales
        LD B,64
GENATM0 ;
        LD (IY),#C3
        LD (IY+1),L
        LD (IY+2),H
        LD (IY+3),0
       PUSH BC
        EXD 
        LD C,(HL)
        INC HL
       PUSH HL
        LD B,(HL) ;BC=scale
        EXD 
        CALL GENATMPP
       POP DE
        INC DE
       POP BC
        INC IY,IY,IY,IY
        DJNZ GENATM0
        ;LD IY,23610
        ;EI 
        RET 

tgenatmhead
        jr NC,$+4
        SET 5,H ;todo LD H,
         ADD A,L ;todo skip if L<=-40
        LD L,A
         jr NC,$+3 ;todo skip if L<=-40
         INC H   ;todo skip if L<=-40
lgenatmhead=$-tgenatmhead

GENATMPP
;BC=scale
;HL=prog
        LD A,C
        LD (genC),A
        LD A,B
        LD (genB),A
        EXD 
        XOR A
        LD L,A,H,A
        SBC HL,BC ;-scale = -#40..-#410
        ADD HL,HL
        ADD HL,HL
        ADD HL,HL
        ADD HL,HL
        ADD HL,HL ;*32 = -#800..-#8200
        EXD 
        LD LX,E
        LD E,D
        LD D,-1
        LD A,E
        ADD A,Ycenter ;#64
        LD E,A
        jr NC,$+3
        INC D
;DE = Y
;LX = y
       PUSH DE ;Y
        LD A,D
        OR A
        jr NZ,GENTOP
        LD A,E
        CP Ytop
        jr C,GENTOP
        CALL YtoADDR
        JR GENnTOP
GENTOP  LD DE,scrtop
GENnTOP
       IF addhlbc
        LD A,#80
        LD (genpix0),A ;первый раз
        LD (HL),#21 ;ld hl,NN
        INC HL
        LD (HL),E
        INC HL
        LD (HL),D
        INC HL
        PUSH BC,DE
        EXD 
        LD HL,tgenatmhead
        LD BC,lgenatmhead
        LDIR 
        EXD 
        POP DE,BC
       ELSE 
        LD A,#80
        LD (genpix0),A ;первый раз
        LD A,D
        OR E
        LD (HL),#EB ;exd
        jr Z,GENTOPH
         LD (HL),#21 ;ld hl,NN
         INC HL
         LD (HL),E
         INC HL
         LD (HL),D
         INC HL
         LD (HL),#19 ;add hl,de
GENTOPH INC HL
      ;ELSE
      ; LD A,D
      ; SUB 'scrtop ;значение A при входе
      ; JZ GENTOPH
      ;  LD (HL),#C6 ;add a,N
      ;  INC HL
      ;  LD (HL),D
      ;  INC HL
;GENTOPH LD (HL),#67 ;ld h,a
       ;INC HL
       ENDIF 
       IF addhlbc == 0
        LD A,D
        LD (curH),A
        LD (HL),#D1 ;pop de
        INC HL
       ENDIF 
       POP DE ;Y
        LD HX,0 ;V
GENATMPP0
       ;Y+=scale
        LD A,LX
genC=$+1
        ADD A,0
        LD LX,A ;y
        LD A,0
genB=$+1
        ADC A,0 ;A=dY
        jr Z,GENATMnPIX
        LD B,A
GENATMPIX0
        CALL GENATMPIX
        INC DE
        LD A,D
        OR A
        jr NZ,$+7
         LD A,E
         CP Ybottom
         jr NC,GENATMPPQ
        DJNZ GENATMPIX0
GENATMnPIX
        INC HX
        LD A,HX
        CP 64
        jr Z,GENATMPPQ
        RRA 
        jr C,$+5
         LD (HL),#D1 ;pop de
         INC HL
        JR GENATMPP0
GENATMPPQ
       IF addhlbc == 0
       LD A,#D1 ;skip pop de's
       DEC HL
       CP (HL)
       jr Z,$-2
        LD A,(HL)
        CP #72 ;ld (hl),d
       ELSE 
genatmend=$+1
        LD HL,0
       ENDIF 
        LD (HL),#DD
       IF addhlbc == 0
        jr NZ,$+5
         INC HL
         LD (HL),#FD
       ENDIF 
        INC HL
        LD (HL),#E9 ;jp (ix) ;(iy) for ld (hl),d
        INC HL
        RET 

YtoADDR
       PUSH HL
        LD H,D,L,E
        ADD HL,HL
        ADD HL,HL
        ADD HL,DE ;*5
        ADD HL,HL
        ADD HL,HL
        ADD HL,HL ;*40
        LD DE,scrbase
        ADD HL,DE
genX=$+1
        LD DE,0
        ADD HL,DE
        EXD 
       POP HL
        RET 

       ;LD (HL),#32 ;ld (),a
       ;INC HL
       ;LD (HL),E
       ;INC HL
       ;LD (HL),D
       ;INC HL

GENATMPIX
        LD A,D
        OR A
        RET NZ
        LD A,E
        CP Ytop
        RET C
       PUSH DE ;Y
        CALL YtoADDR
       IF addhlbc
genpix0=$+1
        LD A,#80
        ADD A,A
        LD (genpix0),A
        jr C,$+5 ;первый раз
         LD (HL),#09 ;add hl,bc
         INC HL
       ELSE 
genpix0=$+1
        LD A,#80
        ADD A,A
        LD (genpix0),A
        jr C,GENPIXQ ;первый раз
curH=$+1
        LD A,0
        INC A
        CP D
        LD A,D
        LD (curH),A
        jr NZ,GENPIXnH
        ;LD (HL),#24 ;inc h
         LD (HL),#09 ;add hl,bc
         INC HL
        JR GENPIXQ
GENPIXnH
       LD A,E
      ;OR A
      ;LD (HL),#68 ;ld l,b
      ;JZ GENPIXL
      ;CP 40 ;только для каждого 8-го столба
      ;LD (HL),#69 ;ld l,c
      ;JZ GENPIXL
       CP #B8
       LD (HL),#6F ;ld l,a
       jr Z,GENPIXL
         LD (HL),#2E ;ld l,N
         INC HL
         LD (HL),E
GENPIXL INC HL
GENPIXQ
       ENDIF ;~addhlbc
        LD A,HX ;V
        RRA 
        LD (HL),#73 ;ld (hl),e
        jr NC,$+4
        LD (HL),#72 ;ld (hl),d
        INC HL
       IF addhlbc
       LD (genatmend),HL
       ENDIF 
       POP DE ;Y
        RET 

        align 256;DS .(-$)
tscales
       IF customscales == 0
        INCBIN "scalesw3" ;сначала мелкие
       ELSE 
        DS 8,5,0
        DS 7,6,0
        DS 6,7,0
        DS 5,8,0
        DS 4,9,0
        DS 3,10,0
        DS 2,11,0
        DS 1,12,0
        DS 1,13,0
        DS 1,14,0
        DS 1,15,0
        DS 1,16,0
        DS 1,17,0
        DS 1,18,0
        DS 1,19,0
        DS 1,20,0
        DS 1,21,0
        DS 1,22,0
        DS 1,23,0
        DS 1,24,0
        DS 1,25,0
        DS 1,26,0
        DS 1,27,0
        DS 1,28,0
        DS 1,29,0
        DS 1,30,0
        DS 1,31,0
        DS 1,32,0
        DS 1,33,0
        DS 1,34,0
        DS 1,35,0
        DS 1,36,0
        DS 1,38,0
        DS 1,40,0
        DS 1,42,0
        DS 1,44,0
        DISPLAY $-tscales,"=#80"
       ENDIF 
