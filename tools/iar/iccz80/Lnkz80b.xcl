/*
                 -LNKZ80B.XCL-

        XLINK 4.xx command file to be used with the Z80/64180 C-compiler V4.xx
	using the -mb and default -v0 options.
        Usage:  xlink  your_file(s)  -f lnkz80b


	$Revision: 1.4 $ 
*/
//    First: define CPU  
-cz80

//  Set Motorola format, 24 bit addresses  
-Fmotorola

/*
    In this example banks are defined to work with the MMU in cs64180 
    Banked code area is 4000-7FFF. The physical memory banks starts at 50000 
    Banks are selected by BBR, here BBR will be 4C,50,54,58... 
    Set the "bank" segments initial_address,size,size*10  
*/
-b(CODE)CODE=4C4000,4000,40000

/*
    If using a simple latch to select memory banks: 
    Set the "bank" segments initial_address,size,bankincrement  
    -b(CODE)CODE=4000,4000,10000 banks will be numbered 00,01,02... 

    The interrupts vectors are supposed to start at 3F00
    and take 256 (FFH) bytes                              
*/

-Z(CODE)INTVEC=3F00-3FFF

/*
    Then the writeable segments which must be mapped to a RAM area
    8000 was here supposed to be start of RAM.
    Note: Stack size is set to 512 (200H) bytes with 'CSTACK+200    
*/    

-Z(DATA)DATA0,IDATA0,UDATA0,ECSTR,TEMP,CSTACK+200=8000-FFFF

//  Set the "root" segments to 0  

-Z(CODE)RCODE,CDATA0,CONST,CSTR,CCSTR=100-3EFF

//  See configuration section concerning printf/sprintf  
-e_small_write=_formatted_write

//  See configuration section concerning scanf/sscanf  
-e_medium_read=_formatted_read

//  Load the 'C' library  
clz80b

/*
    The i/o address to the bank switch register in 
    this example is set to BBR, which the cs64180 simulator uses 
*/    

-D?BANK_SWITCH_PORT_L08=39 

/*
    Following defines the initial values the MMU registers CBAR and CBR 
    will have after each reset in the cs64180 simulator 
*/

-DCBAR_value=84
-DCBR_value=0


//  Code will now reside on file aout.a01 in Motorola S format  

