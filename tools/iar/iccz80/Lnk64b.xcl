/*
                 -LNK64B.XCL-

        XLINK 4.xx command file to be used with the Z80/64180 C-compiler V4.xx
	using the -mb and -v1 options.
        Usage:  xlink  your_file(s)  -f lnk64b


  	$Revision: 1.4 $ 
*/        
//    First: define CPU  

-cz80

//  Set Motorola format, 24 bit addresses  
-Fmotorola

//  Banks are selected by BBR, here BBR will be 4C,50,54,58... 
//  Set the "bank" segments initial_address,size,size*10  
-b(CODE)CODE=4C4000,4000,40000

/*
    Set the "data" segments to the (logical) RAM address 
    8000 was here supposed to be start of RAM.
    Note: Stack size is set to 512 (200H) bytes with 'CSTACK+200    
*/

-Z(DATA)DATA0,IDATA0,UDATA0,ECSTR,TEMP,CSTACK+200=8000-FFFF

/*
    Set the "root" segments to 100
    0-FF is left free for RST routines 
*/

-Z(CODE)RCODE,CDATA0,CONST,CSTR,CCSTR=100-3EFF

/*
    The interrupts vectors are supposed to start at 3F00
    and take 256 (FFH) bytes                              
*/    

-Z(CODE)INTVEC=3F00-3FFF

//  See configuration section concerning printf/sprintf  
-e_small_write=_formatted_write

//  See configuration section concerning scanf/sscanf  
-e_medium_read=_formatted_read

//  Load the 'C' library  
cl64180b

/*
    Initialize MMU registers
    NOTE: The MMU register seting shown below maps logical memory:
    0000-3FFF to physical memory 0000-3FFF.
    4000-7FFF to physical memory banks starting at 50000-
    8000-FFFF to physical memory 10000-17FFF.
    It is possible to map logical memory to other parts of physical
    memory by changing the MMU registers seting
    (for details see MMU description in processor's manual)  
*/

-DCBAR_value=84
-DCBR_value=08

//  Code will now reside on file aout.a01 in Motorola S format  



